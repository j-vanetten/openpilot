VERSION ""

BO_ 258 STEERING: 8 XXX
 SG_ COUNTER : 55|4@0+ (1,0) [0|15] "" XXX
 SG_ CHECKSUM : 63|8@0+ (1,0) [0|255] "" XXX
 SG_ UNKNOWN_STEERING : 50|3@0+ (1,0) [0|15] "" XXX
 SG_ STEERING_RATE : 20|13@0+ (0.3187251,-1305.498) [0|8191] "deg/s" XXX
 SG_ STEER_ANGLE : 4|13@0+ (0.3187251,-1307.888) [-360|360] "deg" XXX
 SG_ PADDLE_SHIFT_DOWN : 35|1@0+ (1,0) [0|1] "" XXX
 SG_ PADDLE_SHIFT_UP : 34|1@0+ (1,0) [0|1] "" XXX

BO_ 817 CAR_MODES: 8 XXX
 SG_ ECO_ON : 21|1@0+ (1,0) [0|1] "" XXX
 SG_ SPORT_ON : 22|1@0+ (1,0) [0|1] "" XXX

BO_ 706 c_1: 8 XXX
 SG_ LAT_ANGLE : 18|11@0+ (-0.00048828125,0.5) [-0.5|0.49951171875] "" XXX
 SG_ LONG_DIST : 35|12@0+ (0.0625,0) [0|255.93752] "m" XXX
 SG_ COUNTER : 55|4@0+ (1,0) [0|15] "" XXX
 SG_ CHECKSUM : 63|8@0+ (1,0) [0|255] "" XXX

BO_ 708 c_2: 8 XXX
 SG_ LAT_ANGLE : 18|11@0+ (-0.00048828125,0.5) [-0.5|0.49951171875] "" XXX
 SG_ LONG_DIST : 35|12@0+ (0.0625,0) [0|255.93752] "m" XXX
 SG_ COUNTER : 55|4@0+ (1,0) [0|15] "" XXX
 SG_ CHECKSUM : 63|8@0+ (1,0) [0|255] "" XXX

BO_ 710 c_3: 8 XXX
 SG_ LAT_ANGLE : 18|11@0+ (-0.00048828125,0.5) [-0.5|0.49951171875] "" XXX
 SG_ LONG_DIST : 35|12@0+ (0.0625,0) [0|255.93752] "m" XXX
 SG_ COUNTER : 55|4@0+ (1,0) [0|15] "" XXX
 SG_ CHECKSUM : 63|8@0+ (1,0) [0|255] "" XXX

BO_ 712 c_4: 8 XXX
 SG_ LAT_ANGLE : 18|11@0+ (-0.00048828125,0.5) [-0.5|0.49951171875] "" XXX
 SG_ LONG_DIST : 35|12@0+ (0.0625,0) [0|255.93752] "m" XXX
 SG_ COUNTER : 55|4@0+ (1,0) [0|15] "" XXX
 SG_ CHECKSUM : 63|8@0+ (1,0) [0|255] "" XXX

BO_ 714 c_5: 8 XXX
 SG_ LAT_ANGLE : 18|11@0+ (-0.00048828125,0.5) [-0.5|0.49951171875] "" XXX
 SG_ LONG_DIST : 35|12@0+ (0.0625,0) [0|255.93752] "m" XXX
 SG_ COUNTER : 55|4@0+ (1,0) [0|15] "" XXX
 SG_ CHECKSUM : 63|8@0+ (1,0) [0|255] "" XXX

BO_ 716 c_6: 8 XXX
 SG_ LAT_ANGLE : 18|11@0+ (-0.00048828125,0.5) [-0.5|0.49951171875] "" XXX
 SG_ LONG_DIST : 35|12@0+ (0.0625,0) [0|255.93752] "m" XXX
 SG_ COUNTER : 55|4@0+ (1,0) [0|15] "" XXX
 SG_ CHECKSUM : 63|8@0+ (1,0) [0|255] "" XXX

BO_ 718 c_7: 8 XXX
 SG_ LAT_ANGLE : 18|11@0+ (-0.00048828125,0.5) [-0.5|0.49951171875] "" XXX
 SG_ LONG_DIST : 35|12@0+ (0.0625,0) [0|255.93752] "m" XXX
 SG_ COUNTER : 55|4@0+ (1,0) [0|15] "" XXX
 SG_ CHECKSUM : 63|8@0+ (1,0) [0|255] "" XXX

BO_ 720 c_8: 8 XXX
 SG_ LAT_ANGLE : 18|11@0+ (-0.00048828125,0.5) [-0.5|0.49951171875] "" XXX
 SG_ LONG_DIST : 35|12@0+ (0.0625,0) [0|255.93752] "m" XXX
 SG_ COUNTER : 55|4@0+ (1,0) [0|15] "" XXX
 SG_ CHECKSUM : 63|8@0+ (1,0) [0|255] "" XXX

BO_ 722 c_9: 8 XXX
 SG_ LAT_ANGLE : 18|11@0+ (-0.00048828125,0.5) [-0.5|0.49951171875] "" XXX
 SG_ LONG_DIST : 35|12@0+ (0.0625,0) [0|255.93752] "m" XXX
 SG_ COUNTER : 55|4@0+ (1,0) [0|15] "" XXX
 SG_ CHECKSUM : 63|8@0+ (1,0) [0|255] "" XXX

BO_ 724 c_10: 8 XXX
 SG_ LAT_ANGLE : 18|11@0+ (-0.00048828125,0.5) [-0.5|0.49951171875] "" XXX
 SG_ LONG_DIST : 35|12@0+ (0.0625,0) [0|255.93752] "m" XXX
 SG_ COUNTER : 55|4@0+ (1,0) [0|15] "" XXX
 SG_ CHECKSUM : 63|8@0+ (1,0) [0|255] "" XXX

BO_ 674 d_1: 8 XXX
 SG_ REL_SPEED : 19|12@0+ (0.25,-128) [-128|127] "m/s" XXX
 SG_ MEASURED : 51|1@0+ (1,0) [0|1] "" XXX
 SG_ PROBABILITY : 15|8@0+ (1,0) [0|255] "" XXX
 SG_ COUNTER : 55|4@0+ (1,0) [0|15] "" XXX
 SG_ CHECKSUM : 63|8@0+ (1,0) [0|255] "" XXX

BO_ 676 d_2: 8 XXX
 SG_ REL_SPEED : 19|12@0+ (0.25,-128) [-128|127] "m/s" XXX
 SG_ MEASURED : 51|1@0+ (1,0) [0|1] "" XXX
 SG_ PROBABILITY : 15|8@0+ (1,0) [0|255] "" XXX
 SG_ COUNTER : 55|4@0+ (1,0) [0|15] "" XXX
 SG_ CHECKSUM : 63|8@0+ (1,0) [0|255] "" XXX

BO_ 678 d_3: 8 XXX
 SG_ REL_SPEED : 19|12@0+ (0.25,-128) [-128|127] "m/s" XXX
 SG_ MEASURED : 51|1@0+ (1,0) [0|1] "" XXX
 SG_ PROBABILITY : 15|8@0+ (1,0) [0|255] "" XXX
 SG_ COUNTER : 55|4@0+ (1,0) [0|15] "" XXX
 SG_ CHECKSUM : 63|8@0+ (1,0) [0|255] "" XXX

BO_ 680 d_4: 8 XXX
 SG_ REL_SPEED : 19|12@0+ (0.25,-128) [-128|127] "m/s" XXX
 SG_ MEASURED : 51|1@0+ (1,0) [0|1] "" XXX
 SG_ PROBABILITY : 15|8@0+ (1,0) [0|255] "" XXX
 SG_ COUNTER : 55|4@0+ (1,0) [0|15] "" XXX
 SG_ CHECKSUM : 63|8@0+ (1,0) [0|255] "" XXX

BO_ 682 d_5: 8 XXX
 SG_ REL_SPEED : 19|12@0+ (0.25,-128) [-128|127] "m/s" XXX
 SG_ MEASURED : 51|1@0+ (1,0) [0|1] "" XXX
 SG_ PROBABILITY : 15|8@0+ (1,0) [0|255] "" XXX
 SG_ COUNTER : 55|4@0+ (1,0) [0|15] "" XXX
 SG_ CHECKSUM : 63|8@0+ (1,0) [0|255] "" XXX

BO_ 684 d_6: 8 XXX
 SG_ REL_SPEED : 19|12@0+ (0.25,-128) [-128|127] "m/s" XXX
 SG_ MEASURED : 51|1@0+ (1,0) [0|1] "" XXX
 SG_ PROBABILITY : 15|8@0+ (1,0) [0|255] "" XXX
 SG_ COUNTER : 55|4@0+ (1,0) [0|15] "" XXX
 SG_ CHECKSUM : 63|8@0+ (1,0) [0|255] "" XXX

BO_ 686 d_7: 8 XXX
 SG_ REL_SPEED : 19|12@0+ (0.25,-128) [-128|127] "m/s" XXX
 SG_ MEASURED : 51|1@0+ (1,0) [0|1] "" XXX
 SG_ PROBABILITY : 15|8@0+ (1,0) [0|255] "" XXX
 SG_ COUNTER : 55|4@0+ (1,0) [0|15] "" XXX
 SG_ CHECKSUM : 63|8@0+ (1,0) [0|255] "" XXX

BO_ 688 d_8: 8 XXX
 SG_ REL_SPEED : 19|12@0+ (0.25,-128) [-128|127] "m/s" XXX
 SG_ MEASURED : 51|1@0+ (1,0) [0|1] "" XXX
 SG_ PROBABILITY : 15|8@0+ (1,0) [0|255] "" XXX
 SG_ COUNTER : 55|4@0+ (1,0) [0|15] "" XXX
 SG_ CHECKSUM : 63|8@0+ (1,0) [0|255] "" XXX

BO_ 690 d_9: 8 XXX
 SG_ REL_SPEED : 19|12@0+ (0.25,-128) [-128|127] "m/s" XXX
 SG_ MEASURED : 51|1@0+ (1,0) [0|1] "" XXX
 SG_ PROBABILITY : 15|8@0+ (1,0) [0|255] "" XXX
 SG_ COUNTER : 55|4@0+ (1,0) [0|15] "" XXX
 SG_ CHECKSUM : 63|8@0+ (1,0) [0|255] "" XXX

BO_ 692 d_10: 8 XXX
 SG_ REL_SPEED : 19|12@0+ (0.25,-128) [-128|127] "m/s" XXX
 SG_ MEASURED : 51|1@0+ (1,0) [0|1] "" XXX
 SG_ PROBABILITY : 15|8@0+ (1,0) [0|255] "" XXX
 SG_ COUNTER : 55|4@0+ (1,0) [0|15] "" XXX
 SG_ CHECKSUM : 63|8@0+ (1,0) [0|255] "" XXX
